/* ov5640 camera module */

&i2c2 {
       ov5640_mipi: ov5640_mipi@3c { /* i2c2 driver */
               compatible = "ovti,ov5640_mipi";
               reg = <0x3c>;
               clocks = <&clks 201>;
               clock-names = "csi_mclk";
               DOVDD-supply = <&vgen4_reg>; /* 1.8v */
               AVDD-supply = <&vgen3_reg>;  /* 2.8v, rev C board is VGEN3
                                               rev B board is VGEN5 */
               DVDD-supply = <&vgen2_reg>;  /* 1.5v*/
               pwn-gpios = <&gpio1 19 1>;   /* active low: SD1_CLK */
               rst-gpios = <&gpio1 20 0>;   /* active high: SD1_DAT2 */
               ipu_id = <0>;
               csi_id = <1>;
               vc = <0>;
               mclk = <24000000>;
               mclk_source = <0>;
               status="okay";
       };
};
